## FPGA/Saturn/SaturnLinux/buildroot/configfiles/configs/numato_saturn_v3_defconfig
```kconfig
BR2_microblaze=y
BR2_microblazeel=y
BR2_TARGET_GENERIC_GETTY_PORT="ttyUL0"
BR2_TARGET_GENERIC_GETTY_BAUDRATE_115200=y
BR2_TARGET_GENERIC_GETTY_BAUDRATE="115200"
BR2_TARGET_GENERIC_GETTY_TERM="vt100"
BR2_TARGET_GENERIC_GETTY_OPTIONS=""
# BR2_TARGET_ROOTFS_TAR is not set
BR2_TARGET_ROOTFS_INITRAMFS=y
BR2_LINUX_KERNEL=y
BR2_LINUX_KERNEL_USE_CUSTOM_CONFIG=y
BR2_LINUX_KERNEL_CUSTOM_CONFIG_FILE="board/numato/saturn_v3/saturn_v3_defconfig"
BR2_LINUX_KERNEL_USE_CUSTOM_DTS=y
BR2_LINUX_KERNEL_CUSTOM_DTS_PATH="board/numato/saturn_v3/saturn_v3.dts"

BR2_TARGET_GENERIC_HOSTNAME="saturn-v3"
BR2_TARGET_GENERIC_ISSUE="Welcome to Saturn V3 FPGA module - XC6SLX45 + Microblaze + Linux"
```

## FPGA/galatea/galateaLinux-BSP/numato_galatea_defconfig
```kconfig
BR2_microblaze=y
BR2_microblazeel=y
BR2_TARGET_GENERIC_GETTY_PORT="ttyUL0"
BR2_TARGET_GENERIC_GETTY_BAUDRATE_115200=y
BR2_TARGET_GENERIC_GETTY_BAUDRATE="115200"
BR2_TARGET_GENERIC_GETTY_TERM="vt100"
BR2_TARGET_GENERIC_GETTY_OPTIONS=""
# BR2_TARGET_ROOTFS_TAR is not set
BR2_TARGET_ROOTFS_INITRAMFS=y
BR2_LINUX_KERNEL=y
BR2_LINUX_KERNEL_USE_CUSTOM_CONFIG=y
BR2_TARGET_ENABLE_ROOT_LOGIN=y
BR2_TARGET_GENERIC_PASSWD_MD5=y
BR2_TARGET_GENERIC_PASSWD_METHOD="md5"
BR2_INIT_BUSYBOX=y
BR2_TARGET_TZ_INFO=y
BR2_TARGET_TZ_ZONELIST="default"
BR2_TARGET_LOCALTIME="Asia/Kolkata"
BR2_TARGET_GENERIC_ROOT_PASSWD="galatea"
BR2_SYSTEM_BIN_SH_BUSYBOX=y

BR2_LINUX_KERNEL_CUSTOM_CONFIG_FILE="board/numato/galatea/galatea_defconfig"
BR2_LINUX_KERNEL_USE_CUSTOM_DTS=y
BR2_LINUX_KERNEL_CUSTOM_DTS_PATH="board/numato/galatea/galatealx45t.dts"

BR2_TARGET_GENERIC_HOSTNAME="NumatoLab-Galatea"
BR2_TARGET_GENERIC_ISSUE="Welcome to Galatea FPGA module - XC6SLX45T + Microblaze + Linux"
```

## FPGA/neso/nesoLinux-BSP/numato_neso_defconfig
```kconfig
BR2_microblaze=y
BR2_microblazeel=y
BR2_TARGET_GENERIC_GETTY_PORT="ttyUL0"
BR2_TARGET_GENERIC_GETTY_BAUDRATE_115200=y
BR2_TARGET_GENERIC_GETTY_BAUDRATE="115200"
BR2_TARGET_GENERIC_GETTY_TERM="vt100"
BR2_TARGET_GENERIC_GETTY_OPTIONS=""
# BR2_TARGET_ROOTFS_TAR is not set
BR2_TARGET_ROOTFS_INITRAMFS=y
BR2_LINUX_KERNEL=y
BR2_LINUX_KERNEL_USE_CUSTOM_CONFIG=y
BR2_TARGET_ENABLE_ROOT_LOGIN=y
BR2_TARGET_GENERIC_PASSWD_MD5=y
BR2_TARGET_GENERIC_PASSWD_METHOD="md5"
BR2_INIT_BUSYBOX=y
BR2_TARGET_TZ_INFO=y
BR2_TARGET_TZ_ZONELIST="default"
BR2_TARGET_LOCALTIME="Asia/Kolkata"
BR2_TARGET_GENERIC_ROOT_PASSWD="neso"
BR2_SYSTEM_BIN_SH_BUSYBOX=y
BR2_LINUX_KERNEL_CUSTOM_CONFIG_FILE="board/numato/neso/neso_defconfig"
BR2_LINUX_KERNEL_USE_CUSTOM_DTS=y
BR2_LINUX_KERNEL_CUSTOM_DTS_PATH="board/numato/neso/nesoartix7.dts"

BR2_TARGET_GENERIC_HOSTNAME="NumatoLab-Neso"
BR2_TARGET_GENERIC_ISSUE="Welcome to Microblaze + Linux on Artix7 FPGA"
```

## FPGA/opsis/opsisLinux-BSP/numato_opsis_defconfig
```kconfig
BR2_microblaze=y
BR2_microblazeel=y
BR2_TARGET_GENERIC_GETTY_PORT="ttyUL1"
BR2_TARGET_GENERIC_GETTY_BAUDRATE_115200=y
BR2_TARGET_GENERIC_GETTY_BAUDRATE="115200"
BR2_TARGET_GENERIC_GETTY_TERM="vt100"
BR2_TARGET_GENERIC_GETTY_OPTIONS=""
# BR2_TARGET_ROOTFS_TAR is not set
BR2_TARGET_ROOTFS_INITRAMFS=y
BR2_LINUX_KERNEL=y
BR2_LINUX_KERNEL_USE_CUSTOM_CONFIG=y

BR2_LINUX_KERNEL_CUSTOM_CONFIG_FILE="board/numato/opsis/opsis_defconfig"
BR2_LINUX_KERNEL_USE_CUSTOM_DTS=y
BR2_LINUX_KERNEL_CUSTOM_DTS_PATH="board/numato/opsis/opsis.dts"

BR2_TARGET_GENERIC_HOSTNAME="opsis"
BR2_TARGET_GENERIC_ISSUE="Welcome to Opsis FPGA module - XC6SLX45T + Microblaze + Linux"
```

## FPGA/skoll/skollLinux-BSP/numato_skoll_defconfig
```kconfig
BR2_microblaze=y
BR2_microblazeel=y
BR2_TARGET_GENERIC_GETTY_PORT="ttyUL1"
BR2_TARGET_GENERIC_GETTY_BAUDRATE_115200=y
BR2_TARGET_GENERIC_GETTY_BAUDRATE="115200"
BR2_TARGET_GENERIC_GETTY_TERM="vt100"
BR2_TARGET_GENERIC_GETTY_OPTIONS=""
# BR2_TARGET_ROOTFS_TAR is not set
BR2_TARGET_ROOTFS_INITRAMFS=y
BR2_LINUX_KERNEL=y
BR2_LINUX_KERNEL_USE_CUSTOM_CONFIG=y
BR2_TARGET_ENABLE_ROOT_LOGIN=y
BR2_TARGET_GENERIC_PASSWD_MD5=y
BR2_TARGET_GENERIC_PASSWD_METHOD="md5"
BR2_INIT_BUSYBOX=y
BR2_TARGET_TZ_INFO=y
BR2_TARGET_TZ_ZONELIST="default"
BR2_TARGET_LOCALTIME="UTC"
BR2_TARGET_GENERIC_ROOT_PASSWD="root"
BR2_SYSTEM_BIN_SH_BUSYBOX=y
BR2_LINUX_KERNEL_CUSTOM_CONFIG_FILE="board/numato/skoll/skoll_defconfig"
BR2_LINUX_KERNEL_USE_CUSTOM_DTS=y
BR2_LINUX_KERNEL_CUSTOM_DTS_PATH="board/numato/skoll/skollkintex7.dts"

BR2_TARGET_GENERIC_HOSTNAME="NumatoLab-Skoll"
BR2_TARGET_GENERIC_ISSUE="Welcome to Microblaze + Linux on 7-series FPGA"
```
